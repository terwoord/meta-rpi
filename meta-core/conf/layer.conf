## meta-core/conf/layer.conf
```bitbake
# We have a conf and classes directory, add to BBPATH
BBPATH .= ":${LAYERDIR}"

# We have recipes-* directories, add to BBFILES
BBFILES += "${LAYERDIR}/recipes-*/*/*.bb \
	${LAYERDIR}/recipes-*/*/*.bbappend"

BBFILE_COLLECTIONS += "tw-core-layer"
BBFILE_PATTERN_tw-core-layer = "^${LAYERDIR}/"
BBFILE_PRIORITY_tw-core-layer = "6"

# This should only be incremented on significant changes that will
# cause compatibility issues with other layers
LAYERVERSION_filesystems-layer = "1"
```

## meta-mender/conf/layer.conf
```bitbake
# We have a conf and classes directory, add to BBPATH
BBPATH .= ":${LAYERDIR}"

# We have recipes-* directories, add to BBFILES
BBFILES += "${LAYERDIR}/recipes-*/*/*.bb \
	${LAYERDIR}/recipes-*/*/*.bbappend"

BBFILE_COLLECTIONS += "meta-tw-rpi-core"
BBFILE_PATTERN_meta-tw-rpi-core = "^${LAYERDIR}/"
BBFILE_PRIORITY_meta-tw-rpi-core = "6"

LAYERSERIES_meta-tw-rpi-core = "thud"
```
